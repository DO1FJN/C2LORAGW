## components/HAMdLNK/Kconfig.projbuild
```kconfig
menu "HAMdLNK - HAM-d-Link Config"
  config HAMDLNK_PORT_MAIN
    int "IP port number (incoming+outgoing UDP)"
    range 1 65535
    default 30003
    help
      "Listen on this port for incoming HAMdLNK streams, forwarding on UHF is not in dongle mode"

  config HAMDLNK_PORT_2ND
    int "2nd port (incoming+outgoing UDP)"
    range 1 65535
    default 30004
    help
      "If not in dongle mode, streaming to this port for local audio out"

  config MAX_USERDATA
    int "Maximum Userdata (Incoming UDP)"
    range 2 16
    default 4
    help
       "Defines how many incomping UDP-RTP stream can be handled in parallel (UNUSED!)"


endmenu
```

## components/localaudio/Kconfig.projbuild
```kconfig
menu "Local Audio Configuration"

  config AUDIOOUT_DEFAULT_0DB
    hex "default multiplicator for 0dB out"
    range   0x00100 0x80000
    default 0x10000
    help
      "default multiplicator for 0dB audio output (volume)"

  config AUDIOIN_DEFAULT_0DB
    hex "default multiplicator for 0dB in"
    range   0x00080 0x10000
    default 0x00800
    help
      "default multiplicator for 0dB audio input (mic gain)"

    
endmenu
```

## components/network/Kconfig.projbuild
```kconfig
menu "Network Configuration"

  config DEVICE_NAME
    string "Device Name (for WPS as default network name)"
    help
      Enter a useful devicename (LoraGateway)...

  choice USE_WIFI
      prompt "WiFi Usage"
      default INTERNAL_WIFI
      help
	    Enable or disable the internal WiFi functionality for this target.

      config NO_WIFI
	  bool "Disabled"
	  help
	      Disables WiFi - can't be used with this FW.

      config INTERNAL_WIFI
	  bool "Enabled / STA"
	  help
	      WiFi is present and can be used.

  endchoice

  choice USE_ETHERNET
      prompt "Ethernet Usage"
      default NO_ETHERNET
      help
	    Enable od disable ethernet (LAN8720A phy) for this target.

      config NO_ETHERNET
	  bool "Disabled"
	  help
	    Disables ethernet functionality.

      config INTERNAL_ETHERNET
	  depends on IDF_TARGET_ESP32
	  bool "Internal EMAC"
	  help
	    Select internal Ethernet MAC controller.

  endchoice


  if INTERNAL_ETHERNET

  config ETH_AUTODETECT_PHY
    bool "Ethernet PHY autodetection"
    default false
    help
      Test GPIO pin MDIO for 10K pullup (only presend if PHY attached)

  config ETH_PHY_RST_GPIO
	  int "PHY Reset GPIO number"
	  default 5
	  help
	    Set the GPIO number used to reset PHY chip.
	    Set to -1 to disable PHY chip hardware reset.

	config ETH_PHY_ADDR
	    int "PHY Address"
	    range 0 1
	    default 1
	    help
		  Set PHY address of the LAN8720A (RXER/PHYADR0 level after reset).

        config ETH_MDC_GPIO
            int "SMI MDC GPIO number"
            default 23
            help
                Set the GPIO number used by SMI MDC.

        config ETH_MDIO_GPIO
            int "SMI MDIO GPIO number"
            default 18
            help
                Set the GPIO number used by SMI MDIO.

  endif

endmenu
```

## components/ui_128x64x1/Kconfig.projbuild
```kconfig
menu "User Interface (OLED Display)"
  depends on TARGET_C2LOARAGW_V1 || TARGET_HELTEC_WIFILORA_V3

  config DISPLAY_GOES_DARK_S
    int "display off timeout (s)" 
    range   0 1200
    default 15
    help
      "duration after the display goes dark (1-1200 seconds; 0 = feature turnd off)"
    
endmenu
```

## main/Kconfig.projbuild
```kconfig
menu "Target and Board Configuration"

    choice C2LORAGW_TARGET
      prompt "Target / Board"
      default TARGET_BREADBOARD
      help
        Set the board target.
  
      config TARGET_BREADBOARD
        bool "Breadboard"
  
      config TARGET_HELTEC_WIFILORA_V3
        bool "Heltec WiFi LoRa 32 V3"

      config TARGET_C2LOARAGW_V1
        bool "C2 Lora Gateway HW 1"
  
      config TARGET_LILYGO_TDECK
        bool "LILYGO T-Deck"
    
    endchoice

    config BOOT_FAIL_LED
      int "Boot Fail LED indicator IO pin"
      depends on TARGET_C2LOARAGW_V1 || TARGET_BREADBOARD
      range -1 47
      default 0
      help
        Shows a blink pattern on this IO pin, if somethin goes wrong during startup.

    config LOCALAUDIO_ENABLED
      bool "Local audio"
      default true
      help 
        Enables microphone and speaker capabilities using I2S.

    config LOCAL_PTT_ENABLED
      bool "Local PTT key"
      depends on LOCALAUDIO_ENABLED
      default true
      help
        Allows to talk by holing the PTT key down.

    config LOCAL_PTT_IOPIN
      int "PTT IO pin number"
      depends on LOCAL_PTT_ENABLED
      range 0 47
      default 0
      help
        Select the IO pin for a push button wired to GND.

    config LOW_FREQUENCY_RANGE_MHZ
      int "Lowest frequency allowed (in MHz)"
      range   410 490
      default 430
      help
        Lowest frequency C2LORA will transmit.

    config HIGH_FREQUENCY_RANGE_MHZ
      int "Highest frequency allowed (in MHz)"
      range   410 490
      default 440
      help
        Highest frequency C2LORA will transmit.
    
endmenu

menu "Feature Configuration"

  config DEFAULT_FREQUENCY_HZ
    int "Default frequency (in Hz)"
    range   430000000 440000000
    default 433075000
    help
      Default frequency the tranceiver is set to, if no NVM data is set.

  config DEFAULT_C2LORA_MODE
    int "Default C2LORA mode"
    range 0 9
    default 4
    help
      Default C2LORA mode, if no NVM parameter is set (default 4 = 15KHz, 1600bit/s).


  config DEFAULT_CALLSIGN
    string "Default callsign if noting else is configured"
    help
      Enter a useful callsign...

  choice DEFAULT_KOS
    prompt "Kind Of Station"
    default KOS_HOTSPOT
    config KOS_PORTABLE
      bool "Portable Radio"
    config KOS_MOBILE
      bool "Mobile Radio"  
    config KOS_STATION
      bool "Station/Indoor"
    config KOS_HOTSPOT
      bool "Hotspot"  
    config KOS_RELAY
      bool "Relay (Full Duplex, 2 Modules)"
  endchoice

  config USE_TEST_BITPATTERN
    bool "Use Testpatterns on TX"
    default n
    help
      Use 01 01 01 01 02 02 02 02 test data instead of real speech frames and shows received.
      data as hex buffers (no audio output).

  config PLAIN_PASSWORDS
    bool "Show Wifi passwords withing configuration files"
    default n
    help
      Enabling this shows stored passwords in configuration files written to an USB stick.

  config PARSE_INI_DEBUG
    bool "Debug print INI lines while parsing"
    default n
    help
      Enabling this shows stored now the configuration is parsed.

endmenu
```
